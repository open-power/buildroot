## configs/powerpc64_petitboot_defconfig
```kconfig
BR2_powerpc64=y
BR2_GENERATE_LOCALE="en_US.UTF-8"
BR2_ROOTFS_DEVICE_CREATION_DYNAMIC_EUDEV=y
BR2_TARGET_GENERIC_GETTY_PORT="hvc0"
BR2_PACKAGE_BUSYBOX_SHOW_OTHERS=y
BR2_PACKAGE_LINUX_FIRMWARE=y
BR2_PACKAGE_LINUX_FIRMWARE_BNX2X=y
BR2_PACKAGE_LINUX_FIRMWARE_CXGB4=y
BR2_PACKAGE_NCURSES_WCHAR=y
BR2_PACKAGE_DROPBEAR=y
# BR2_PACKAGE_DROPBEAR_SERVER is not set
BR2_PACKAGE_ETHTOOL=y
BR2_PACKAGE_NETCAT=y
BR2_PACKAGE_RSYNC=y
BR2_PACKAGE_PETITBOOT=y
BR2_TARGET_ROOTFS_CPIO=y
BR2_TARGET_ROOTFS_CPIO_XZ=y
```

## firmware/Config.in
```kconfig
menu "System Firmware"

source "firmware/hostboot/Config.in"
source "firmware/skiboot/Config.in"

endmenu
```

## firmware/hostboot/Config.in
```kconfig
config BR2_TARGET_HOSTBOOT
        bool "hostboot"
	depends on BR2_powerpc_power8
	depends on BR2_CPP
        help
            Hostboot is low-level firmware for POWER8 machines. It is
	    responsible for early CPU, memory and CEC initialisation.


if BR2_TARGET_HOSTBOOT

config BR2_TARGET_HOSTBOOT_CONFIG
        string "Hostboot hardware configuration file"
        help
            Define a custom hardware configuration file. If none is provided,
	    hostboot defaults will be used.

endif
```

## firmware/skiboot/Config.in
```kconfig
config BR2_TARGET_SKIBOOT
	bool "skiboot"
	depends on BR2_powerpc64
	help
	  Build skiboot POWER8 firmware
```

## package/ipmitool/Config.in
```kconfig
config BR2_PACKAGE_IPMITOOL
	bool "ipmitool"
	help
	  IPMI (Intelligent Platform Management Interface) tool

	  IPMItool provides a simple command-line interface to IPMI-enabled
	  devices through an IPMIv1.5 or IPMIv2.0 LAN interface or
	  Linux/Solaris kernel driver.
```

## package/powerpc-utils/Config.in
```kconfig
config BR2_PACKAGE_POWERPC_UTILS
	bool "powerpc-utils"
	select BR2_PACKAGE_ZLIB
	help
	  System utilities for powerpc machines
```
